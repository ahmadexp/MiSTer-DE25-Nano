/dts-v1/;
/plugin/;

/ {
    fragment@0 {
        target-path = "/memory";

        __overlay__ {
            reg = <0x00000000 0x80000000 0x00000000 0x40000000>;
        };
    };

    fragment@1 {
        target-path = "/reserved-memory";

        __overlay__ {
            pc110@b0000000 {
                reg = <0x00000000 0xb0000000 0x00000000 0x10000000>;
                no-map;
            };
        };
    };
};
